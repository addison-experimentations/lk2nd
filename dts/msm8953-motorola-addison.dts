// SPDX-License-Identifier: GPL-2.0-only

/dts-v1/;
 
/include/ "msm8953.dtsi"
/include/ "motorola-carrier-channel-ids.dtsi"
/ {
	// This is used by the bootloader to find the correct DTB
	qcom,msm-id = <182 0x0>; // qcom,msm-id = <247 0>; for APQ8016, need to change soon
	qcom,board-id = <0x43 0x8700>,
                    <0x42 0x8400>,
                    <0x42 0x8300>,
                    <0x41 0x82a0>,
                    <0x41 0x8100>;

	model = "Motorola Moto Z Play (addison)"; // FIXME
	compatible = "motorola,addison", "qcom,msm8953-addison", "qcom,msm8953-moto", "qcom,msm8953", "lk2nd,device"; // FIXME
		lk2nd,motorola-unitinfo = <1>;
	panel {
		compatible = "motorola,addison-panel";

		qcom,mdss_dsi_mot_smd_549_1080p_cmd_v0 {
			compatible = "tianma,tl052vdxp02";
		};
		qcom,mdss_dsi_mot_boe_520_1080p_vid_v0 {
			compatible = "boe,bs052fhm-a00-6c01";
		};
	};
};
